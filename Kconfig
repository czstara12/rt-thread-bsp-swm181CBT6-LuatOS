## Kconfig
```kconfig
mainmenu "RT-Thread Configuration"

config BSP_DIR
    string
    option env="BSP_ROOT"
    default "."

config RTT_DIR
    string
    option env="RTT_ROOT"
    default "../../.."

config PKGS_DIR
    string
    option env="PKGS_ROOT"
    default "packages"

source "$RTT_DIR/Kconfig"
source "$PKGS_DIR/Kconfig"
source "drivers/Kconfig"

config SOC_SWM181
    bool
    select ARCH_ARM_CORTEX_M0
    default y
```

## drivers/Kconfig
```kconfig
menu "Hardware Drivers Config"

    menu "On-chip Peripheral Drivers"

        config BSP_USING_GPIO
            bool "Enable GPIO"
            select RT_USING_PIN
            default y

        menu "UART Drivers"
            config BSP_USING_UART0
                bool "Enable UART0"
                select RT_USING_SERIAL
                default y
            if BSP_USING_UART0
                config BSP_UART0_RX_PIN
                    string "UART0 RX Pin name (for example PA0, avoid PA2/PA3)"
                    default "PA0"
                config BSP_UART0_TX_PIN
                    string "UART0 TX Pin name (for example PA1, avoid PA2/PA3)"
                    default "PA1"
            endif

            config BSP_USING_UART1
                bool "Enable UART1"
                select RT_USING_SERIAL
                default n
            if BSP_USING_UART1
                config BSP_UART1_RX_PIN
                    string "UART1 RX Pin name (for example PA10)"
                    default "PA10"
                config BSP_UART1_TX_PIN
                    string "UART1 TX Pin name (for example PA11)"
                    default "PA11"
            endif

            config BSP_USING_UART2
                bool "Enable UART2"
                select RT_USING_SERIAL
                default n
            if BSP_USING_UART2
                config BSP_UART2_RX_PIN
                    string "UART2 RX Pin name (for example PB2)"
                    default "PB2"
                config BSP_UART2_TX_PIN
                    string "UART2 TX Pin name (for example PB3)"
                    default "PB3"
            endif

            config BSP_USING_UART3
                bool "Enable UART3"
                select RT_USING_SERIAL
                default n
            if BSP_USING_UART3
                config BSP_UART3_RX_PIN
                    string "UART3 RX Pin name (for example PC6)"
                    default "PC6"
                config BSP_UART3_TX_PIN
                    string "UART3 TX Pin name (for example PC7)"
                    default "PC7"
            endif
        endmenu

        config BSP_USING_WDT
            bool "Enable Watch Dog"
            select RT_USING_WDT
            default n

        config BSP_USING_ADC
            bool "Enable ADC"
            select RT_USING_ADC
            default n

        config BSP_USING_CAN
            bool "Enable CAN"
            select RT_USING_CAN
            default n
        if BSP_USING_CAN
            config BSP_CAN_RX_PIN
                string "CAN RX Pin name (for example PA12)"
                default "PA12"
            config BSP_CAN_TX_PIN
                string "CAN TX Pin name (for example PA13)"
                default "PA13"
        endif

        menu "I2C Drivers"
            config BSP_USING_I2C0
                bool "Enable I2C0 BUS"
                select RT_USING_I2C
                default n
            if BSP_USING_I2C0
                config BSP_I2C0_SCL_PIN
                    string "I2C0 SCL Pin name (for example PA12)"
                    default "PA12"
                config BSP_I2C0_SDA_PIN
                    string "I2C0 SDA Pin name (for example PA13)"
                    default "PA13"
            endif

            config BSP_USING_I2C1
                bool "Enable I2C1 BUS"
                select RT_USING_I2C
                default n
            if BSP_USING_I2C1
                config BSP_I2C1_SCL_PIN
                    string "I2C1 SCL Pin name (for example PB7)"
                    default "PB7"
                config BSP_I2C1_SDA_PIN
                    string "I2C1 SDA Pin name (for example PB6)"
                    default "PB6"
            endif
        endmenu

        menu "PWM Drivers"
            config BSP_USING_PWM0
                bool "Using PWM0"
                select RT_USING_PWM
                default n
            if BSP_USING_PWM0
                config BSP_PWM0_CH1_PIN
                    string "PWM0 Channel A Pin name (default PA8)"
                    default "PA8"
                config BSP_PWM0_CH2_PIN
                    string "PWM0 Channel B Pin name (default PA9)"
                    default "PA9"
            endif

            config BSP_USING_PWM1
                bool "Using PWM1"
                select RT_USING_PWM
                default n
            if BSP_USING_PWM1
                config BSP_PWM1_CH1_PIN
                    string "PWM1 Channel A Pin name (default PB6)"
                    default "PB6"
                config BSP_PWM1_CH2_PIN
                    string "PWM1 Channel B Pin name (default PB7)"
                    default "PB7"
            endif

            config BSP_USING_PWM2
                bool "Using PWM2"
                select RT_USING_PWM
                default n
            if BSP_USING_PWM2
                config BSP_PWM2_CH1_PIN
                    string "PWM2 Channel A Pin name (default PA12)"
                    default "PA12"
                config BSP_PWM2_CH2_PIN
                    string "PWM2 Channel B Pin name (default PA13)"
                    default "PA13"
            endif

            config BSP_USING_PWM3
                bool "Using PWM3"
                select RT_USING_PWM
                default n
            if BSP_USING_PWM3
                config BSP_PWM3_CH1_PIN
                    string "PWM3 Channel A Pin name (default PA14)"
                    default "PA14"
                config BSP_PWM3_CH2_PIN
                    string "PWM3 Channel B Pin name (default PA15)"
                    default "PA15"
            endif
        endmenu

        menu "SPI Drivers"
            config BSP_USING_SPI0
                bool "Enable SPI0 BUS"
                select RT_USING_SPI
                default n 
            if BSP_USING_SPI0
                config BSP_SPI0_PIN_GRP_A
                    bool "Use PA9/10/11 (MCU Pin Index 9/10/11)"
                    default y
                config BSP_SPI0_PIN_GRP_B
                    bool "Use PA13/14/15 (MCU Pin Index 13/14/15)"
                    default n
            endif

            config BSP_USING_SPI1
                bool "Enable SPI1 BUS"
                select RT_USING_SPI
                default n
            if BSP_USING_SPI1
                config BSP_SPI1_PIN_FIXED
                    bool "Fixed on PC5/6/7 (MCU Pin Index 37/38/39)"
                    default y
            endif
        endmenu

    endmenu

    menu "Onboard Peripheral Drivers"

    endmenu

    menu "Offboard Peripheral Drivers"

    endmenu

    config SOC_SWM181CBT6
        bool
        select RT_USING_COMPONENTS_INIT
        select RT_USING_USER_MAIN
        default y

endmenu
```
